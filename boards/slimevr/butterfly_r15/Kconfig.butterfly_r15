## boards/slimevr/butterfly_r15/Kconfig.butterfly_r15
```kconfig
# Copyright (c) 2024 Nordic Semiconductor ASA
# SPDX-License-Identifier: Apache-2.0

config BOARD_SLIMEVR_BUTTERFLY_R15
	select SOC_NRF52833_QIAA
```

## boards/slimevr/butterfly_r15/board.yml
```yaml
# Copyright (c) 2024 Nordic Semiconductor ASA
# SPDX-License-Identifier: Apache-2.0

board:
  name: butterfly_r15_uf2
  full_name: Butterfly Tracker
  vendor: slimevr
  socs:
    - name: nrf52833
```

## boards/slimevr/slimevrglove/Kconfig.defconfig
```kconfig
config HW_STACK_PROTECTION
	default ARCH_HAS_STACK_PROTECTION

if BOARD_SLIMEVRGLOVE_NRF54L15_CPUAPP

config ROM_START_OFFSET
	default 0 if PARTITION_MANAGER_ENABLED
	default 0x800 if BOOTLOADER_MCUBOOT

endif # BOARD_SLIMEVRGLOVE_NRF54L15_CPUAPP
```

## boards/slimevr/slimevrglove/Kconfig.slimevrglove
```kconfig
config BOARD_SLIMEVRGLOVE
	select SOC_NRF54L15_CPUAPP if BOARD_SLIMEVRGLOVE_NRF54L15_CPUAPP
```

## boards/slimevr/slimevrglove/board.yml
```yaml
board:
  name: slimevrglove
  vendor: nighty-electronics
  socs:
  - name: nrf54l15
    variants:
    - name: xip
      cpucluster: cpuflpr
```

## boards/slimevr/slimevrglove/slimevrglove_nrf54l15_cpuapp_defconfig
```kconfig
CONFIG_ARM_MPU=y
CONFIG_HW_STACK_PROTECTION=y

CONFIG_USB_DEVICE_STACK=y
CONFIG_USB_DEVICE_MANUFACTURER="SlimeVR"
CONFIG_USB_DEVICE_PRODUCT="SlimeVR Glove"

CONFIG_BATTERY_USE_REG_BUCK_MAPPING=y
CONFIG_LED_RGB_COLOR=y
CONFIG_SENSOR_ROTATION_90=y

CONFIG_SENSOR_USE_MAG=n

CONFIG_SYS_CLOCK_HW_CYCLES_PER_SEC=1000000
CONFIG_SYS_CLOCK_TICKS_PER_SEC=32768

CONFIG_NRFX_GRTC=y
CONFIG_NRFX_GPPI=y

# use grtc as system timer
CONFIG_NRF_GRTC_TIMER=y
CONFIG_NRF_GRTC_START_SYSCOUNTER=y

# Enable LFRC (internal RC oscillator)
CONFIG_CLOCK_CONTROL_NRF_K32SRC_RC=y

# Disable LFXO (external 32kHz crystal)
CONFIG_CLOCK_CONTROL_NRF_K32SRC_XTAL=n

# Disable synthesized LFCLK from HFCLK
CONFIG_CLOCK_CONTROL_NRF_K32SRC_SYNTH=n

CONFIG_CLOCK_CONTROL_NRF_K32SRC_500PPM=y
CONFIG_CLOCK_CONTROL_NRF_K32SRC_RC_CALIBRATION=y
CONFIG_CLOCK_CONTROL_NRF_CALIBRATION_LF_ALWAYS_ON=y

CONFIG_BT=n
```

## boards/slimevr/slimevrglove_left/Kconfig.slimevrglove_left
```kconfig
config BOARD_SLIMEVRGLOVE_LEFT
	select SOC_NRF54L15_CPUAPP if BOARD_SLIMEVRGLOVE_LEFT_NRF54L15_CPUAPP
```

## boards/slimevr/slimevrglove_left/board.yml
```yaml
board:
  name: slimevrglove_left
  vendor: slimevr
  socs:
    - name: nrf54l15
      variants:
        - name: xip
          cpucluster: cpuflpr
```

## boards/slimevr/slimevrmini_p4r11_uf2/slimevrmini_p4r11_uf2_defconfig
```kconfig
# Copyright (c) 2024 Nordic Semiconductor ASA
# SPDX-License-Identifier: Apache-2.0

CONFIG_ARM_MPU=y
CONFIG_HW_STACK_PROTECTION=y

CONFIG_USB_DEVICE_STACK=y
CONFIG_USB_DEVICE_MANUFACTURER="SlimeVR"
CONFIG_USB_DEVICE_PRODUCT="Butterfly P4R11"

CONFIG_BATTERY_USE_REG_BUCK_MAPPING=y
CONFIG_LED_RGB_COLOR=y
CONFIG_SENSOR_ROTATION_90=y

#generate for adafruit uf2 bootloader flashing
CONFIG_BUILD_OUTPUT_UF2=y
CONFIG_FLASH_LOAD_OFFSET=0x1000

# MAG on aux I2C yet not supported #77
CONFIG_SENSOR_USE_MAG=n

# Use XTAL FULL SWING clock source for TDMA
CONFIG_CLOCK_SOURCE_XTAL_FULL=y
```

## sysbuild/SlimeVR-Tracker-nRF/boards/mochi_uf2.conf
```kconfig
CONFIG_USB_DEVICE_STACK=y
CONFIG_USB_DEVICE_MANUFACTURER="Mocha-Elec"
CONFIG_USB_DEVICE_PRODUCT="Mochi"

CONFIG_BATTERY_USE_REG_BUCK_MAPPING=y
CONFIG_LED_RGB_COLOR=y
CONFIG_SENSOR_ROTATION_0=y
```

## sysbuild/SlimeVR-Tracker-nRF/boards/promicro_uf2_chrysalis_defconfig
```kconfig
CONFIG_USB_DEVICE_STACK=y
CONFIG_USB_DEVICE_MANUFACTURER="SlimeVR"
CONFIG_USB_DEVICE_PRODUCT="SlimeNRF Tracker Pro Micro"

CONFIG_BATTERY_USE_REG_LDO_MAPPING=y
CONFIG_LED_RGB_COLOR=y
CONFIG_SENSOR_ROTATION_270=y
```

## sysbuild/SlimeVR-Tracker-nRF/boards/slimenrf_r1.conf
```kconfig
CONFIG_USB_DEVICE_STACK=n

CONFIG_BATTERY_USE_REG_BUCK_MAPPING=y
CONFIG_SENSOR_ROTATION_270_FLIPPED=y
```

## sysbuild/SlimeVR-Tracker-nRF/boards/slimenrf_r3.conf
```kconfig
CONFIG_USB_DEVICE_STACK=y
CONFIG_USB_DEVICE_MANUFACTURER="sctanf"
CONFIG_USB_DEVICE_PRODUCT="SlimeNRF Tracker R3"

CONFIG_BATTERY_USE_REG_BUCK_MAPPING=y
CONFIG_SENSOR_ROTATION_270_FLIPPED=y
```

## sysbuild/SlimeVR-Tracker-nRF/boards/slimevrmini_p1_uf2.conf
```kconfig
CONFIG_USB_DEVICE_STACK=y
CONFIG_USB_DEVICE_MANUFACTURER="SlimeVR"
CONFIG_USB_DEVICE_PRODUCT="SlimeVR Mini Tracker P1"

CONFIG_BATTERY_USE_REG_BUCK_MAPPING=y
CONFIG_SENSOR_ROTATION_90=y
```

## sysbuild/SlimeVR-Tracker-nRF/boards/slimevrmini_p4_uf2.conf
```kconfig
CONFIG_USB_DEVICE_STACK=y
CONFIG_USB_DEVICE_MANUFACTURER="SlimeVR"
CONFIG_USB_DEVICE_PRODUCT="SlimeVR Butterfly P4"

CONFIG_BATTERY_USE_REG_BUCK_MAPPING=y
CONFIG_LED_RGB_COLOR=y
CONFIG_SENSOR_ROTATION_90=y

CONFIG_SENSOR_USE_MAG=n
```

## sysbuild/SlimeVR-Tracker-nRF/boards/slimevrmini_p4r11_uf2.conf
```kconfig
CONFIG_USB_DEVICE_STACK=y
CONFIG_USB_DEVICE_MANUFACTURER="SlimeVR"
CONFIG_USB_DEVICE_PRODUCT="Butterfly P4R11"

CONFIG_BATTERY_USE_REG_BUCK_MAPPING=y
CONFIG_LED_RGB_COLOR=y
CONFIG_SENSOR_ROTATION_90=y

# MAG on aux I2C yet not supported #77
CONFIG_SENSOR_USE_MAG=n
```
