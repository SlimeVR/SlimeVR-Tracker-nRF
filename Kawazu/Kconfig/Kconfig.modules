## boards/slimevr/slimevrmini_p4r9_uf2/board.yml
```yaml
# Copyright (c) 2024 Nordic Semiconductor ASA
# SPDX-License-Identifier: Apache-2.0

board:
  name: slimevrmini_p4r9_uf2
  full_name: Butterfly P4R9
  vendor: slimevr
  socs:
    - name: nrf52833
```

## sysbuild/SlimeVR-Tracker-nRF/boards/nrf5340dk_nrf5340_cpuapp.conf
```kconfig
CONFIG_USB_DEVICE_STACK=y
CONFIG_USB_DEVICE_MANUFACTURER="Nordic Semiconductor"
CONFIG_USB_DEVICE_PRODUCT="SlimeNRF Tracker nRF5340 DK"

CONFIG_ESB=n
```
