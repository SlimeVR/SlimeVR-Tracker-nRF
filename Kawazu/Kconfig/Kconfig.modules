## Kawazu/Kconfig/Kconfig.modules
```kconfig
menu "nrf (C:/ncs/v2.9.0/nrf)"
osource "C:/ncs/v2.9.0/nrf/Kconfig.nrf"
config ZEPHYR_NRF_MODULE
	bool
	default y
endmenu
menu "mcuboot (C:/ncs/v2.9.0/bootloader/mcuboot)"
osource "$(ZEPHYR_MCUBOOT_KCONFIG)"
config ZEPHYR_MCUBOOT_MODULE
	bool
	default y
endmenu
menu "mbedtls (C:/ncs/v2.9.0/modules/crypto/mbedtls)"
osource "$(ZEPHYR_MBEDTLS_KCONFIG)"
config ZEPHYR_MBEDTLS_MODULE
	bool
	default y
endmenu
menu "oberon-psa-crypto (C:/ncs/v2.9.0/modules/crypto/oberon-psa-crypto)"
osource "C:/ncs/v2.9.0/modules/crypto/oberon-psa-crypto/Kconfig.oberon_psa_crypto"
config ZEPHYR_OBERON_PSA_CRYPTO_MODULE
	bool
	default y
endmenu
menu "trusted-firmware-m (C:/ncs/v2.9.0/modules/tee/tf-m/trusted-firmware-m)"
osource "$(ZEPHYR_TRUSTED_FIRMWARE_M_KCONFIG)"
config ZEPHYR_TRUSTED_FIRMWARE_M_MODULE
	bool
	default y
endmenu
config ZEPHYR_PSA_ARCH_TESTS_MODULE
	bool
	default y
config ZEPHYR_SOC_HWMV1_MODULE
	bool
	default y
menu "cjson (C:/ncs/v2.9.0/modules/lib/cjson)"
osource "$(ZEPHYR_CJSON_KCONFIG)"
config ZEPHYR_CJSON_MODULE
	bool
	default y
endmenu
menu "azure-sdk-for-c (C:/ncs/v2.9.0/modules/lib/azure-sdk-for-c)"
osource "$(ZEPHYR_AZURE_SDK_FOR_C_KCONFIG)"
config ZEPHYR_AZURE_SDK_FOR_C_MODULE
	bool
	default y
endmenu
menu "cirrus-logic (C:/ncs/v2.9.0/modules/hal/cirrus-logic)"
osource "C:/ncs/v2.9.0/modules/hal/cirrus-logic/Kconfig"
config ZEPHYR_CIRRUS_LOGIC_MODULE
	bool
	default y
endmenu
menu "openthread (C:/ncs/v2.9.0/modules/lib/openthread)"
osource "$(ZEPHYR_OPENTHREAD_KCONFIG)"
config ZEPHYR_OPENTHREAD_MODULE
	bool
	default y
endmenu
menu "suit-generator (C:/ncs/v2.9.0/modules/lib/suit-generator)"
osource "C:/ncs/v2.9.0/modules/lib/suit-generator/ncs/Kconfig"
config ZEPHYR_SUIT_GENERATOR_MODULE
	bool
	default y
endmenu
menu "suit-processor (C:/ncs/v2.9.0/modules/lib/suit-processor)"
osource "C:/ncs/v2.9.0/modules/lib/suit-processor/Kconfig"
config ZEPHYR_SUIT_PROCESSOR_MODULE
	bool
	default y
endmenu
menu "memfault-firmware-sdk (C:/ncs/v2.9.0/modules/lib/memfault-firmware-sdk)"
osource "C:/ncs/v2.9.0/modules/lib/memfault-firmware-sdk/ports/zephyr/Kconfig"
config ZEPHYR_MEMFAULT_FIRMWARE_SDK_MODULE
	bool
	default y
endmenu
menu "coremark (C:/ncs/v2.9.0/modules/benchmark/coremark)"
osource "$(ZEPHYR_COREMARK_KCONFIG)"
config ZEPHYR_COREMARK_MODULE
	bool
	default y
endmenu
menu "canopennode (C:/ncs/v2.9.0/modules/lib/canopennode)"
osource "$(ZEPHYR_CANOPENNODE_KCONFIG)"
config ZEPHYR_CANOPENNODE_MODULE
	bool
	default y
endmenu
menu "chre (C:/ncs/v2.9.0/modules/lib/chre)"
osource "C:/ncs/v2.9.0/modules/lib/chre/platform/zephyr/Kconfig"
config ZEPHYR_CHRE_MODULE
	bool
	default y
endmenu
menu "lz4 (C:/ncs/v2.9.0/modules/lib/lz4)"
osource "$(ZEPHYR_LZ4_KCONFIG)"
config ZEPHYR_LZ4_MODULE
	bool
	default y
endmenu
menu "nanopb (C:/ncs/v2.9.0/modules/lib/nanopb)"
osource "$(ZEPHYR_NANOPB_KCONFIG)"
config ZEPHYR_NANOPB_MODULE
	bool
	default y
endmenu
config ZEPHYR_TF_M_TESTS_MODULE
	bool
	default y
menu "zscilib (C:/ncs/v2.9.0/modules/lib/zscilib)"
osource "C:/ncs/v2.9.0/modules/lib/zscilib/Kconfig.zscilib"
config ZEPHYR_ZSCILIB_MODULE
	bool
	default y
endmenu
menu "cmsis (C:/ncs/v2.9.0/modules/hal/cmsis)"
osource "$(ZEPHYR_CMSIS_KCONFIG)"
config ZEPHYR_CMSIS_MODULE
	bool
	default y
endmenu
menu "cmsis-dsp (C:/ncs/v2.9.0/modules/lib/cmsis-dsp)"
osource "$(ZEPHYR_CMSIS_DSP_KCONFIG)"
config ZEPHYR_CMSIS_DSP_MODULE
	bool
	default y
endmenu
menu "cmsis-nn (C:/ncs/v2.9.0/modules/lib/cmsis-nn)"
osource "$(ZEPHYR_CMSIS_NN_KCONFIG)"
config ZEPHYR_CMSIS_NN_MODULE
	bool
	default y
endmenu
menu "fatfs (C:/ncs/v2.9.0/modules/fs/fatfs)"
osource "$(ZEPHYR_FATFS_KCONFIG)"
config ZEPHYR_FATFS_MODULE
	bool
	default y
endmenu
menu "hal_nordic (C:/ncs/v2.9.0/modules/hal/nordic)"
osource "$(ZEPHYR_HAL_NORDIC_KCONFIG)"
config ZEPHYR_HAL_NORDIC_MODULE
	bool
	default y

config ZEPHYR_HAL_NORDIC_MODULE_BLOBS
	bool
endmenu
menu "hal_st (C:/ncs/v2.9.0/modules/hal/st)"
osource "$(ZEPHYR_HAL_ST_KCONFIG)"
config ZEPHYR_HAL_ST_MODULE
	bool
	default y
endmenu
config ZEPHYR_HAL_WURTHELEKTRONIK_MODULE
	bool
	default y
menu "hostap (C:/ncs/v2.9.0/modules/lib/hostap)"
osource "$(ZEPHYR_HOSTAP_KCONFIG)"
config ZEPHYR_HOSTAP_MODULE
	bool
	default y
endmenu
config ZEPHYR_LIBMETAL_MODULE
	bool
	default y
menu "liblc3 (C:/ncs/v2.9.0/modules/lib/liblc3)"
osource "$(ZEPHYR_LIBLC3_KCONFIG)"
config ZEPHYR_LIBLC3_MODULE
	bool
	default y
endmenu
menu "littlefs (C:/ncs/v2.9.0/modules/fs/littlefs)"
osource "$(ZEPHYR_LITTLEFS_KCONFIG)"
config ZEPHYR_LITTLEFS_MODULE
	bool
	default y
endmenu
menu "loramac-node (C:/ncs/v2.9.0/modules/lib/loramac-node)"
osource "$(ZEPHYR_LORAMAC_NODE_KCONFIG)"
config ZEPHYR_LORAMAC_NODE_MODULE
	bool
	default y
endmenu
menu "lvgl (C:/ncs/v2.9.0/modules/lib/gui/lvgl)"
osource "C:/ncs/v2.9.0/modules/lib/gui/lvgl/Kconfig"
config ZEPHYR_LVGL_MODULE
	bool
	default y
endmenu
config ZEPHYR_MIPI_SYS_T_MODULE
	bool
	default y
menu "nrf_wifi (C:/ncs/v2.9.0/modules/lib/nrf_wifi)"
osource "$(ZEPHYR_NRF_WIFI_KCONFIG)"
config ZEPHYR_NRF_WIFI_MODULE
	bool
	default y

config ZEPHYR_NRF_WIFI_MODULE_BLOBS
	bool
endmenu
config ZEPHYR_OPEN_AMP_MODULE
	bool
	default y
menu "picolibc (C:/ncs/v2.9.0/modules/lib/picolibc)"
osource "C:/ncs/v2.9.0/modules/lib/picolibc/zephyr/Kconfig"
config ZEPHYR_PICOLIBC_MODULE
	bool
	default y
endmenu
menu "segger (C:/ncs/v2.9.0/modules/debug/segger)"
osource "$(ZEPHYR_SEGGER_KCONFIG)"
config ZEPHYR_SEGGER_MODULE
	bool
	default y
endmenu
config ZEPHYR_TINYCRYPT_MODULE
	bool
	default y
menu "uoscore-uedhoc (C:/ncs/v2.9.0/modules/lib/uoscore-uedhoc)"
osource "$(ZEPHYR_UOSCORE_UEDHOC_KCONFIG)"
config ZEPHYR_UOSCORE_UEDHOC_MODULE
	bool
	default y
endmenu
menu "zcbor (C:/ncs/v2.9.0/modules/lib/zcbor)"
osource "$(ZEPHYR_ZCBOR_KCONFIG)"
config ZEPHYR_ZCBOR_MODULE
	bool
	default y
endmenu
menu "nrfxlib (C:/ncs/v2.9.0/nrfxlib)"
osource "C:/ncs/v2.9.0/nrfxlib/Kconfig.nrfxlib"
config ZEPHYR_NRFXLIB_MODULE
	bool
	default y
endmenu
config ZEPHYR_NRF_HW_MODELS_MODULE
	bool
	default y
menu "connectedhomeip (C:/ncs/v2.9.0/modules/lib/matter)"
osource "C:/ncs/v2.9.0/modules/lib/matter/config/nrfconnect/chip-module/Kconfig"
config ZEPHYR_CONNECTEDHOMEIP_MODULE
	bool
	default y
endmenu
```

## Kawazu/Kconfig/arch/Kconfig
```kconfig
# Load Zephyr Arch Kconfig descriptions.
osource "C:/ncs/v2.9.0/zephyr/arch/x86/Kconfig"
osource "C:/ncs/v2.9.0/zephyr/arch/xtensa/Kconfig"
osource "C:/ncs/v2.9.0/zephyr/arch/sparc/Kconfig"
osource "C:/ncs/v2.9.0/zephyr/arch/riscv/Kconfig"
osource "C:/ncs/v2.9.0/zephyr/arch/posix/Kconfig"
osource "C:/ncs/v2.9.0/zephyr/arch/nios2/Kconfig"
osource "C:/ncs/v2.9.0/zephyr/arch/mips/Kconfig"
osource "C:/ncs/v2.9.0/zephyr/arch/arm64/Kconfig"
osource "C:/ncs/v2.9.0/zephyr/arch/arm/Kconfig"
osource "C:/ncs/v2.9.0/zephyr/arch/arc/Kconfig"
```

## Kawazu/Kconfig/boards/Kconfig
```kconfig
# Load Zephyr board Kconfig descriptions.
osource "C:/Users/dqmag/SlimeVR-Tracker-nRF/boards/nekumori/kawazu/Kconfig"
```

## Kawazu/Kconfig/boards/Kconfig.defconfig
```kconfig
# Load Zephyr board defconfig descriptions.
osource "C:/Users/dqmag/SlimeVR-Tracker-nRF/boards/nekumori/kawazu/Kconfig.defconfig"
```

## Kawazu/Kconfig/boards/Kconfig.kawazu_uf2
```kconfig
# Load board Kconfig descriptions.
osource "C:/Users/dqmag/SlimeVR-Tracker-nRF/boards/nekumori/kawazu/Kconfig.kawazu_uf2"
```

## Kawazu/Kconfig/soc/Kconfig
```kconfig
# Load Zephyr SoC Kconfig descriptions.
osource "C:/ncs/v2.9.0/zephyr/soc/xlnx/zynqmp/Kconfig"
osource "C:/ncs/v2.9.0/zephyr/soc/xlnx/zynq7000/Kconfig"
osource "C:/ncs/v2.9.0/zephyr/soc/xen/Kconfig"
osource "C:/ncs/v2.9.0/zephyr/soc/ti/simplelink/Kconfig"
osource "C:/ncs/v2.9.0/zephyr/soc/ti/lm3s6965/Kconfig"
osource "C:/ncs/v2.9.0/zephyr/soc/ti/k3/Kconfig"
osource "C:/ncs/v2.9.0/zephyr/soc/telink/tlsr/Kconfig"
osource "C:/ncs/v2.9.0/zephyr/soc/starfive/jh71xx/Kconfig"
osource "C:/ncs/v2.9.0/zephyr/soc/st/stm32/Kconfig"
osource "C:/ncs/v2.9.0/zephyr/soc/snps/qemu_arc/Kconfig"
osource "C:/ncs/v2.9.0/zephyr/soc/snps/nsim/arc_v/Kconfig"
osource "C:/ncs/v2.9.0/zephyr/soc/snps/nsim/arc_classic/Kconfig"
osource "C:/ncs/v2.9.0/zephyr/soc/snps/hsdk4xd/Kconfig"
osource "C:/ncs/v2.9.0/zephyr/soc/snps/hsdk/Kconfig"
osource "C:/ncs/v2.9.0/zephyr/soc/snps/emsk/Kconfig"
osource "C:/ncs/v2.9.0/zephyr/soc/snps/emsdp/Kconfig"
osource "C:/ncs/v2.9.0/zephyr/soc/snps/arc_iot/Kconfig"
osource "C:/ncs/v2.9.0/zephyr/soc/silabs/Kconfig"
osource "C:/ncs/v2.9.0/zephyr/soc/sifive/sifive_freedom/Kconfig"
osource "C:/ncs/v2.9.0/zephyr/soc/sensry/Kconfig"
osource "C:/ncs/v2.9.0/zephyr/soc/rockchip/Kconfig"
osource "C:/ncs/v2.9.0/zephyr/soc/renode/riscv_virtual/Kconfig"
osource "C:/ncs/v2.9.0/zephyr/soc/renode/cortex_r8_virtual/Kconfig"
osource "C:/ncs/v2.9.0/zephyr/soc/renesas/smartbond/Kconfig"
osource "C:/ncs/v2.9.0/zephyr/soc/renesas/rzt2m/Kconfig"
osource "C:/ncs/v2.9.0/zephyr/soc/renesas/rcar/Kconfig"
osource "C:/ncs/v2.9.0/zephyr/soc/renesas/ra/Kconfig"
osource "C:/ncs/v2.9.0/zephyr/soc/raspberrypi/Kconfig"
osource "C:/ncs/v2.9.0/zephyr/soc/quicklogic/eos_s3/Kconfig"
osource "C:/ncs/v2.9.0/zephyr/soc/qemu/virt_riscv/Kconfig"
osource "C:/ncs/v2.9.0/zephyr/soc/qemu/malta/Kconfig"
osource "C:/ncs/v2.9.0/zephyr/soc/openisa/rv32m1/Kconfig"
osource "C:/ncs/v2.9.0/zephyr/soc/nxp/s32/Kconfig"
osource "C:/ncs/v2.9.0/zephyr/soc/nxp/rw/Kconfig"
osource "C:/ncs/v2.9.0/zephyr/soc/nxp/mcx/Kconfig"
osource "C:/ncs/v2.9.0/zephyr/soc/nxp/lpc/Kconfig"
osource "C:/ncs/v2.9.0/zephyr/soc/nxp/layerscape/Kconfig"
osource "C:/ncs/v2.9.0/zephyr/soc/nxp/kinetis/Kconfig"
osource "C:/ncs/v2.9.0/zephyr/soc/nxp/imxrt/Kconfig"
osource "C:/ncs/v2.9.0/zephyr/soc/nxp/imx/Kconfig"
osource "C:/ncs/v2.9.0/zephyr/soc/nuvoton/numicro/Kconfig"
osource "C:/ncs/v2.9.0/zephyr/soc/nuvoton/numaker/Kconfig"
osource "C:/ncs/v2.9.0/zephyr/soc/nuvoton/npcx/Kconfig"
osource "C:/ncs/v2.9.0/zephyr/soc/nuvoton/npcm/Kconfig"
osource "C:/ncs/v2.9.0/zephyr/soc/nordic/Kconfig"
osource "C:/ncs/v2.9.0/zephyr/soc/neorv32/Kconfig"
osource "C:/ncs/v2.9.0/zephyr/soc/native/inf_clock/Kconfig"
osource "C:/ncs/v2.9.0/zephyr/soc/microchip/miv/Kconfig"
osource "C:/ncs/v2.9.0/zephyr/soc/microchip/mec/Kconfig"
osource "C:/ncs/v2.9.0/zephyr/soc/mediatek/mtk_adsp/Kconfig"
osource "C:/ncs/v2.9.0/zephyr/soc/lowrisc/opentitan/Kconfig"
osource "C:/ncs/v2.9.0/zephyr/soc/litex/litex_vexriscv/Kconfig"
osource "C:/ncs/v2.9.0/zephyr/soc/ite/ec/Kconfig"
osource "C:/ncs/v2.9.0/zephyr/soc/intel/raptor_lake/Kconfig"
osource "C:/ncs/v2.9.0/zephyr/soc/intel/lakemont/Kconfig"
osource "C:/ncs/v2.9.0/zephyr/soc/intel/intel_socfpga_std/Kconfig"
osource "C:/ncs/v2.9.0/zephyr/soc/intel/intel_socfpga/Kconfig"
osource "C:/ncs/v2.9.0/zephyr/soc/intel/intel_niosv/Kconfig"
osource "C:/ncs/v2.9.0/zephyr/soc/intel/intel_ish/Kconfig"
osource "C:/ncs/v2.9.0/zephyr/soc/intel/intel_adsp/Kconfig"
osource "C:/ncs/v2.9.0/zephyr/soc/intel/elkhart_lake/Kconfig"
osource "C:/ncs/v2.9.0/zephyr/soc/intel/atom/Kconfig"
osource "C:/ncs/v2.9.0/zephyr/soc/intel/apollo_lake/Kconfig"
osource "C:/ncs/v2.9.0/zephyr/soc/intel/alder_lake/Kconfig"
osource "C:/ncs/v2.9.0/zephyr/soc/infineon/cat3/Kconfig"
osource "C:/ncs/v2.9.0/zephyr/soc/infineon/cat1b/Kconfig"
osource "C:/ncs/v2.9.0/zephyr/soc/infineon/cat1a/Kconfig"
osource "C:/ncs/v2.9.0/zephyr/soc/gd/gd32/Kconfig"
osource "C:/ncs/v2.9.0/zephyr/soc/gaisler/leon3/Kconfig"
osource "C:/ncs/v2.9.0/zephyr/soc/gaisler/gr716a/Kconfig"
osource "C:/ncs/v2.9.0/zephyr/soc/espressif/Kconfig"
osource "C:/ncs/v2.9.0/zephyr/soc/ene/kb1200/Kconfig"
osource "C:/ncs/v2.9.0/zephyr/soc/efinix/sapphire/Kconfig"
osource "C:/ncs/v2.9.0/zephyr/soc/cdns/xtensa_sample_controller/Kconfig"
osource "C:/ncs/v2.9.0/zephyr/soc/cdns/dc233c/Kconfig"
osource "C:/ncs/v2.9.0/zephyr/soc/brcm/bcmvk/Kconfig"
osource "C:/ncs/v2.9.0/zephyr/soc/brcm/bcm2712/Kconfig"
osource "C:/ncs/v2.9.0/zephyr/soc/brcm/bcm2711/Kconfig"
osource "C:/ncs/v2.9.0/zephyr/soc/atmel/sam0/Kconfig"
osource "C:/ncs/v2.9.0/zephyr/soc/atmel/sam/Kconfig"
osource "C:/ncs/v2.9.0/zephyr/soc/aspeed/Kconfig"
osource "C:/ncs/v2.9.0/zephyr/soc/arm/Kconfig"
osource "C:/ncs/v2.9.0/zephyr/soc/arm/beetle/Kconfig"
osource "C:/ncs/v2.9.0/zephyr/soc/andestech/Kconfig"
osource "C:/ncs/v2.9.0/zephyr/soc/ambiq/Kconfig"
osource "C:/ncs/v2.9.0/zephyr/soc/altr/zephyr_nios2f/Kconfig"
osource "C:/ncs/v2.9.0/zephyr/soc/altr/qemu_nios2/Kconfig"
osource "C:/ncs/v2.9.0/zephyr/soc/adi/max32/Kconfig"
```

## boards/mocha-elec/mochi/board.yml
```yaml
# Copyright (c) 2024 Nordic Semiconductor ASA
# SPDX-License-Identifier: Apache-2.0

board:
  name: mochi_uf2
  full_name: Mochi
  vendor: mocha-elec
  socs:
    - name: nrf52833
```

## boards/nekumori/kawazu/board.yml
```yaml
# Copyright (c) 2024 Nordic Semiconductor ASA
# SPDX-License-Identifier: Apache-2.0

board:
  name: kawazu_uf2
  vendor: nekumori
  socs:
    - name: nrf52833
```

## boards/nordic/promicro_uf2/board.yml
```yaml
# Copyright (c) 2024 Nordic Semiconductor ASA
# SPDX-License-Identifier: Apache-2.0

# The 'smspi' board variant is targeted promico stack with the SM-ICM45686-AK09940A 
# where ICM is on SPI, AK is on I2C, external clock disabled.

board:
  name: promicro_uf2
  vendor: nordic
  socs:
    - name: nrf52840
      variants:
      - name: 'i2c'
      - name: 'spi'
      - name: 'smspi'
```

## boards/nordic/promicro_uf2/promicro_uf2_smspi_defconfig
```kconfig
# Copyright (c) 2024 Nordic Semiconductor ASA
# SPDX-License-Identifier: Apache-2.0

# This board variant is targeted promico stack with the SM-ICM45686-AK09940A 
# where ICM is on SPI, AK is on I2C, external clock disabled

CONFIG_ARM_MPU=y
CONFIG_HW_STACK_PROTECTION=y

CONFIG_USB_DEVICE_STACK=y
CONFIG_USB_DEVICE_MANUFACTURER="SlimeVR"
CONFIG_USB_DEVICE_PRODUCT="SlimeNRF Tracker ProMicro"

CONFIG_BATTERY_USE_REG_LDO_MAPPING=y

#generate for adafruit uf2 bootloader flashing
CONFIG_BUILD_OUTPUT_UF2=y
CONFIG_FLASH_LOAD_OFFSET=0x1000

# Disable external clock
CONFIG_USE_SENSOR_CLOCK=n
```

## boards/nordic/test54l/board.yml
```yaml
board:
  name: test54l
  full_name: test54l
  vendor: nordic
  socs:
  - name: nrf54l15
    variants:
    - name: xip
      cpucluster: cpuflpr
```

## boards/sctanf/slimenrf_r1/board.yml
```yaml
# Copyright (c) 2024 Nordic Semiconductor ASA
# SPDX-License-Identifier: Apache-2.0

board:
  name: slimenrf_r1
  full_name: SlimeNRF R1
  vendor: sctanf
  socs:
    - name: nrf52840
```

## boards/slimevr/slimevrmini_p1_uf2/board.yml
```yaml
# Copyright (c) 2024 Nordic Semiconductor ASA
# SPDX-License-Identifier: Apache-2.0

board:
  name: slimevrmini_p1_uf2
  full_name: SlimeVR Mini P1
  vendor: slimevr
  socs:
    - name: nrf52833
```

## boards/slimevr/slimevrmini_p2_uf2/board.yml
```yaml
# Copyright (c) 2024 Nordic Semiconductor ASA
# SPDX-License-Identifier: Apache-2.0

board:
  name: slimevrmini_p2_uf2
  full_name: SlimeVR Mini P2
  vendor: slimevr
  socs:
    - name: nrf52833
```

## boards/slimevr/slimevrmini_p3r6_uf2/board.yml
```yaml
# Copyright (c) 2024 Nordic Semiconductor ASA
# SPDX-License-Identifier: Apache-2.0

board:
  name: slimevrmini_p3r6_uf2
  full_name: smol P3R6
  vendor: slimevr
  socs:
    - name: nrf52833
```

## boards/slimevr/slimevrmini_p3r7_uf2/board.yml
```yaml
# Copyright (c) 2024 Nordic Semiconductor ASA
# SPDX-License-Identifier: Apache-2.0

board:
  name: slimevrmini_p3r7_uf2
  full_name: smol P3R7
  vendor: slimevr
  socs:
    - name: nrf52833
```

## boards/slimevr/slimevrmini_p4_uf2/board.yml
```yaml
# Copyright (c) 2024 Nordic Semiconductor ASA
# SPDX-License-Identifier: Apache-2.0

board:
  name: slimevrmini_p4_uf2
  full_name: Butterfly P4
  vendor: slimevr
  socs:
    - name: nrf52833
```

## boards/slimevr/slimevrmini_p4r11_uf2/board.yml
```yaml
# Copyright (c) 2024 Nordic Semiconductor ASA
# SPDX-License-Identifier: Apache-2.0

board:
  name: slimevrmini_p4r11_uf2
  full_name: Butterfly P4R11
  vendor: slimevr
  socs:
    - name: nrf52833
```
